## board/khadas/defconfigs/kvim3_defconfig
```kconfig
CONFIG_ARM=y
CONFIG_TARGET_MESON_G12B=y
CONFIG_KHADAS_VIM3=y
CONFIG_DM=y
CONFIG_DM_GPIO=y
CONFIG_AML_GPIO=y
CONFIG_SYS_CONFIG_NAME="kvim3"
CONFIG_CMD_BOOTM=y
CONFIG_CMD_FAT=y
CONFIG_CMD_EXT4=y
CONFIG_CMD_SOURCE=y
```
